#include "i2c.h"

//------------------------------------------------------------------------------
// TWI 초기화
//------------------------------------------------------------------------------
void i2c_init(void)
{
    // SCL(PD0), SDA(PD1)은 TWI 하드웨어가 제어하므로 방향은 입력으로 두고
    // 내부 풀업만 켜준다. (모듈에 외부 풀업이 있으면 없어도 동작함)
    DDRD  &= ~((1 << PD0) | (1 << PD1));
    PORTD |=  ((1 << PD0) | (1 << PD1));

    TWSR = 0x00;            // TWPS1:0 = 00 -> 분주율 1
    TWBR = (U8)TWBR_VAL;    // 16MHz 기준 72 -> SCL 100kHz
    TWCR = (1 << TWEN);     // TWI 활성화
}

//------------------------------------------------------------------------------
// START + 슬레이브 주소 전송
//------------------------------------------------------------------------------
void i2c_start(U8 address)
{
    // START 조건 발생
    TWCR = (1 << TWINT) | (1 << TWSTA) | (1 << TWEN);
    while (!(TWCR & (1 << TWINT)));

    // SLA + R/W 전송
    TWDR = address;
    TWCR = (1 << TWINT) | (1 << TWEN);
    while (!(TWCR & (1 << TWINT)));
}

//------------------------------------------------------------------------------
// 1바이트 전송
//------------------------------------------------------------------------------
void i2c_transmit(U8 data)
{
    TWDR = data;
    TWCR = (1 << TWINT) | (1 << TWEN);
    while (!(TWCR & (1 << TWINT)));
}

//------------------------------------------------------------------------------
// STOP 조건
//------------------------------------------------------------------------------
void i2c_stop(void)
{
    TWCR = (1 << TWINT) | (1 << TWEN) | (1 << TWSTO);
    while (TWCR & (1 << TWSTO));    // STOP 완료 대기
}

//------------------------------------------------------------------------------
// n바이트 연속 전송 (START -> 데이터 n개 -> STOP)
//------------------------------------------------------------------------------
void i2c_transmit_nbytes(U8 address, U8 *data, U16 length)
{
    U16 i;

    i2c_start(address | I2C_WRITE);
    for (i = 0; i < length; i++)
    {
        i2c_transmit(data[i]);
    }
    i2c_stop();
}
